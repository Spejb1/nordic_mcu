## CMakeLists.txt
```
cmake_minimum_required(VERSION 3.20.0)
find_package(Zephyr REQUIRED HINTS $ENV{ZEPHYR_BASE})

project(blink_lib)

target_sources(app PRIVATE 
	src/main.cpp
	lib/blink_lib.cpp
	lib/blink_zephyr_objects.c
)
```

## prj.conf
```kconfig
CONFIG_GPIO=y
CONFIG_CPP=y
CONFIG_STATIC_INIT_GNU=y
CONFIG_HEAP_MEM_POOL_SIZE=2048
```

## src/main.cpp
```c
#include <zephyr/kernel.h>
#include <stdio.h>
#include "..\lib\blink_lib.hpp"

static blink_status led_status(7);

int main(void)
{
    if (!led_status.begin()) {
        printf("LED init failed\n");
        return 0;
    }


    while (true){
        k_msleep(2000);
        led_status.add_colour(blink_status::Colour::GREEN); // program working LED
    }
}
```
